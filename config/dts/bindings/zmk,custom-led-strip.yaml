## config/dts/bindings/zmk,custom-led-strip.yaml
```yaml
description: Custom LED strip wrapper for layer-specific lighting

compatible: "zmk,custom-led-strip"

include: led-strip.yaml

properties:
  real-strip:
    type: phandle
    required: true
```

## config/west.yml
```yaml
manifest:
  remotes:
    - name: zmkfirmware
      url-base: https://github.com/zmkfirmware
    - name: mctechnology17
      url-base: https://github.com/mctechnology17
  projects:
    - name: zmk
      remote: zmkfirmware
      revision: main
      import: app/west.yml
    - name: zmk-oled-brightness
      remote: mctechnology17
      revision: main
      path: modules/zmk-oled-brightness
  self:
    path: config
```
